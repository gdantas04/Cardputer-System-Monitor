// https://github.com/gdantas04

#include <Arduino.h>
#include <M5Unified.h>
#include <vector>

#define MAX_TERMS 10 
#define LINE_COUNT 1 

extern const uint8_t processor[];
extern const uint8_t disks[];
extern const uint8_t others[];
extern const uint8_t waiting[];

std::vector<int> points[LINE_COUNT];

int colors[] = { TFT_WHITE };
int point_count;
int zoom = 1;
int xoffset, yoffset, chart_width, chart_height;
int count = 0;
int currentPage = 0;
int prevPage = 1;

float cout = 0;

String listed_disks[10];
String ram_percent, prevRam_percent;
String cpu_percent, prevCpu_percent;
String cpu_freq, prevCpu_freq;
String cpu_temp, prevCpu_temp;
String disk_percent, prevDisk_percent;
String disk_temp, prevDisk_temp;
String bat_percent, prevBat_percent;
String bat_time, prevBat_time;

unsigned long lastUpdateTime = 0;

M5GFX display;



void setup(){
  M5.begin();
  Serial.begin(9600);

  if (M5.Display.isEPD()) {
    M5.Display.setEpdMode(epd_mode_t::epd_fastest);
    M5.Display.invertDisplay(true);
    M5.Display.clear(TFT_BLACK);
  }

  if (M5.Display.width() < M5.Display.height())
  {
    M5.Display.setRotation(M5.Display.getRotation() ^ 1);
  }

  zoom = (M5.Display.width() / 480) + 1;

  M5.Display.drawPng(waiting, ~0u, 0, 0);
}

M5Canvas canvas(&display);

void loop(void){
  M5.update();
  M5.delay(1);
  
  if (Serial.available()) {
      String dado = Serial.readStringUntil('\n'); //reveive the data

      if ((dado) == "newcicle"){
        cout = 0;
      }else{

        if(cout == 1){        
          cpu_percent = dado;
          
        }else if(cout == 2){  
          cpu_freq = dado;
          
        }else if(cout == 3){  
          cpu_temp = dado;

        }else if(cout == 4){  
          disk_percent = dado;

        }else if(cout == 5){  
          int numTerms = 0;
          String terms[MAX_TERMS];
          parseTerms(dado, ',', terms, numTerms);
          for (int i = 0; i < numTerms; i++) {
              listed_disks[i] = terms[i];
          }

        }else if(cout == 6){  
          disk_temp = dado;

        }else if(cout == 7){  
          bat_percent = dado;

        }else if(cout == 8){  
          bat_time = dado;

        }else if(cout == 9){  
          ram_percent = dado;
          cout = -1;
        }
        cout++;
      }

      if (currentPage == 0){
        if (cpu_percent != prevCpu_percent){
          M5.Display.fillRect(3, 28, 74, 25, BLACK);  // update writing area
          prevCpu_percent = cpu_percent;
        }else if (cpu_freq != prevCpu_freq){
          M5.Display.fillRect(3, 28+35, 74, 25, BLACK);
          prevCpu_freq = cpu_freq;
        }else if (cpu_temp != prevCpu_temp){
          M5.Display.fillRect(3, 28+35+35, 74, 25, BLACK);
          prevCpu_temp = cpu_temp;
        }

        if (prevPage != currentPage){
          M5.Display.drawPng(processor, ~0u, 0, 0);
          prevPage = currentPage;
        }

        cpu_plot(88, 29, 150, 106, 100);

        M5.Display.setFont(&fonts::efontCN_16);
        M5.Display.drawString(cpu_percent + " %", 8, 35);
        M5.Display.drawString(cpu_freq + " Mhz", 8, 70);
        M5.Display.drawString(cpu_temp + " °C", 8, 107);
      }

      if (currentPage == 1){
        if (disk_percent != prevDisk_percent){
          M5.Display.fillRect(2, 40, 83, 31, BLACK);
          prevDisk_percent = disk_percent;
        }else if (disk_temp != prevDisk_temp){
          M5.Display.fillRect(2, 95, 83, 31, BLACK);
          prevDisk_temp = disk_temp;
        }

        if (prevPage != currentPage){
          M5.Display.drawPng(disks, ~0u, 0, 0);
          prevPage = currentPage;
        }

        int numDisks = sizeof(listed_disks) / sizeof(listed_disks[0]);

        M5.Display.setFont(&fonts::efontCN_16);
        M5.Display.drawString(disk_percent + " %", 20, 50);
        M5.Display.drawString(disk_temp + " °C", 20, 103);

        for(int h=0; h < numDisks; h++){
          M5.Display.drawString(listed_disks[h], 100, 60+h*20);
        }
      }

      if (currentPage == 2){
        if (bat_percent != prevBat_percent){
          M5.Display.fillRect(2, 40, 83, 31, BLACK);
          prevBat_percent = bat_percent;
        }else if (bat_time != prevBat_time){
          M5.Display.fillRect(2, 95, 83, 31, BLACK);
          prevBat_time = bat_time;
        }else if (ram_percent != prevRam_percent){
          M5.Display.fillRect(89, 42, 148, 89, BLACK);
          prevRam_percent = ram_percent;
        }

        if (prevPage != currentPage){
          M5.Display.drawPng(others, ~0u, 0, 0);
          prevPage = currentPage;
        }

        M5.Display.setFont(&fonts::efontCN_16);
        M5.Display.drawString(bat_percent + " %", 20, 50);
        M5.Display.drawString(bat_time + " min", 15, 103);
        M5.Display.setFont(&fonts::efontCN_24);
        M5.Display.drawString(ram_percent + " %", 125, 75);
      }
      
  }

      
    if (M5.BtnA.wasPressed()) {
      currentPage++;
    }
    
    delay(50); // debounce
    if (currentPage > 2) {
      currentPage = 0;  // Goes back to page 0 
    }
}


void parseTerms(String inputString, char delimiter, String terms[], int &numTerms) {  // created to separate ['info1', 'info2']
    for (int i = 0; i < MAX_TERMS; i++) {
        terms[i] = "";
    }
    numTerms = 0;

    inputString.replace("[", "");
    inputString.replace("]", "");
    inputString.replace("'", "");

    inputString += delimiter;

    int startIndex = 0;
    int endIndex = inputString.indexOf(delimiter);

    while (endIndex != -1 && numTerms < MAX_TERMS) {
        terms[numTerms] = inputString.substring(startIndex, endIndex);
        terms[numTerms].trim();
        numTerms++;

        startIndex = endIndex + 1;
        endIndex = inputString.indexOf(delimiter, startIndex);
    }
}



void update_plot() {
  int virtual_width = chart_width;
  int virtual_height = chart_height;

  for (int i = 0; i < LINE_COUNT; i++) {
    points[i][count % point_count] = virtual_height/2 - ((cpu_percent.toFloat() / 100.0) * (virtual_height)); // Mathematical equation to plot
  }

  ++count;
  M5.Display.waitDisplay();
  M5.Display.startWrite();
  M5.Display.fillRect(xoffset, yoffset, chart_width * zoom, chart_height * zoom, TFT_BLACK);

  int index1 = count % point_count;
  for (int x = 0; x < point_count - 1; x++) {
    int index0 = index1;
    index1 = (index0 + 1) % point_count;

    int y0 = points[0][index0] + (virtual_height >> 1);
    int y1 = points[0][index1] + (virtual_height >> 1);

    M5.Display.drawLine(xoffset + x * zoom, yoffset + y0 * zoom, xoffset + (x + 1) * zoom, yoffset + y1 * zoom, colors[0]);

  }
  M5.Display.endWrite();
}

void cpu_plot(int x, int y, int width, int height, int update_time) {
  xoffset = x;
  yoffset = y;
  chart_width = width;
  chart_height = height;

  point_count = chart_width + 1;

  for (int i = 0; i < LINE_COUNT; i++) {
    points[i].resize(point_count);
  }

  unsigned long currentTime = millis();
  if (currentTime - lastUpdateTime >= update_time) {
    update_plot();
    lastUpdateTime = currentTime;
  }
}


// Images:

constexpr uint8_t processor[] = {
  0x89,0x50,0x4e,0x47,0x0d,0x0a,0x1a,0x0a,0x00,0x00,0x00,0x0d,0x49,0x48,0x44,0x52,
	0x00,0x00,0x00,0xf0,0x00,0x00,0x00,0x87,0x08,0x02,0x00,0x00,0x00,0xa7,0x10,0x43,
	0xbc,0x00,0x00,0x00,0x01,0x73,0x52,0x47,0x42,0x01,0xd9,0xc9,0x2c,0x7f,0x00,0x00,
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	0x44,0xae,0x42,0x60,0x82
};

constexpr uint8_t disks[] = {
  0x89,0x50,0x4e,0x47,0x0d,0x0a,0x1a,0x0a,0x00,0x00,0x00,0x0d,0x49,0x48,0x44,0x52,
	0x00,0x00,0x00,0xf0,0x00,0x00,0x00,0x87,0x08,0x02,0x00,0x00,0x00,0xa7,0x10,0x43,
	0xbc,0x00,0x00,0x00,0x01,0x73,0x52,0x47,0x42,0x01,0xd9,0xc9,0x2c,0x7f,0x00,0x00,
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	0xf0,0x66,0xf7,0x4f,0x00,0x00,0x00,0x00,0x49,0x45,0x4e,0x44,0xae,0x42,0x60,0x82
};


constexpr uint8_t others[] = {
  0x89,0x50,0x4e,0x47,0x0d,0x0a,0x1a,0x0a,0x00,0x00,0x00,0x0d,0x49,0x48,0x44,0x52,
	0x00,0x00,0x00,0xf0,0x00,0x00,0x00,0x87,0x08,0x02,0x00,0x00,0x00,0xa7,0x10,0x43,
	0xbc,0x00,0x00,0x00,0x01,0x73,0x52,0x47,0x42,0x01,0xd9,0xc9,0x2c,0x7f,0x00,0x00,
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	0x42,0x60,0x82
};


constexpr uint8_t waiting[] = {
  0x89,0x50,0x4e,0x47,0x0d,0x0a,0x1a,0x0a,0x00,0x00,0x00,0x0d,0x49,0x48,0x44,0x52,
	0x00,0x00,0x00,0xf0,0x00,0x00,0x00,0x87,0x08,0x02,0x00,0x00,0x00,0xa7,0x10,0x43,
	0xbc,0x00,0x00,0x00,0x01,0x73,0x52,0x47,0x42,0x01,0xd9,0xc9,0x2c,0x7f,0x00,0x00,
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	0xb4,0x5a,0x25,0x00,0x00,0x00,0x00,0x49,0x45,0x4e,0x44,0xae,0x42,0x60,0x82
};
